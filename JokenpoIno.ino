/* Exercício Final de Aula Live 02
 *  Aluno: Thiago Vilella
 *  Link do Curso: https://go.hotmart.com/W8213658G
 *  JokenpoIno Versão: 1.0.0
*/

//Incluindo biblioteca
#include <Arduino.h>
#include <Wire.h>
#include <MicroLCD.h>

//Definindo Pinos
#define pinBot1 8
#define pinBot2 9
#define pinBot3 10
#define pinBot4 11

//String com Icones
//String com logo do BrincandoComIdeias
const PROGMEM uint8_t logo[48 * 48 / 8] = {
0x00, 0x00, 0x00, 0x00, 0x00, 0x00, 0x00, 0x00, 0x00, 0x00, 0x00, 0x80, 0xC0, 0xC0, 0xE0, 0xE0,
0xF0, 0xF0, 0xF8, 0xF8, 0xF8, 0xF8, 0xF8, 0x18, 0x18, 0xF8, 0xF8, 0xF8, 0xF8, 0xF8, 0xF0, 0xF0,
0xE0, 0xE0, 0xC0, 0xC0, 0x80, 0x00, 0x00, 0x00, 0x00, 0x00, 0x00, 0x00, 0x00, 0x00, 0x00, 0x00,
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0x07, 0x03, 0x03, 0x01, 0x00, 0x00, 0x00, 0x00, 0x00, 0x00, 0x00, 0x00, 0x00, 0x00, 0x00, 0x00
};

//Pedra
const PROGMEM uint8_t pedra [48 * 48 / 8] = {
0x00, 0x00, 0x00, 0x80, 0xC0, 0xE0, 0x70, 0x30, 0x38, 0x18, 0x0C, 0x0C, 0x04, 0x04, 0x04, 0x06,
0x0E, 0x06, 0x06, 0x02, 0x02, 0x02, 0x00, 0x01, 0x01, 0x01, 0x03, 0x43, 0x23, 0x36, 0x1E, 0x1C,
0x0C, 0x0C, 0x0C, 0x0C, 0x0C, 0x0C, 0x0C, 0x1C, 0x18, 0x38, 0x70, 0xE0, 0xE0, 0x80, 0x00, 0x00,
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0x71, 0x39, 0x1F, 0x07, 0x00, 0x00, 0x00, 0x00, 0x00, 0x00, 0x00, 0x00, 0x00, 0x00, 0x00, 0x00
};

//Papel
const PROGMEM uint8_t papel[48 * 48 / 8] = {
0x00, 0x00, 0x00, 0x00, 0x00, 0x00, 0x00, 0x00, 0x00, 0x00, 0x00, 0x00, 0x00, 0x00, 0x00, 0x00,
0x00, 0x00, 0x00, 0x00, 0x00, 0x00, 0x00, 0x00, 0x80, 0x60, 0x30, 0x0C, 0x04, 0x02, 0x02, 0x02,
0x02, 0x02, 0xC6, 0x7C, 0x00, 0x00, 0x00, 0x00, 0x00, 0x00, 0x00, 0x00, 0x00, 0x00, 0x00, 0x00,
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0x00, 0x00, 0x00, 0x00, 0x00, 0x00, 0x00, 0x00, 0x00, 0x00, 0x00, 0x00, 0x00, 0x00, 0x00, 0x00
};

//Tesoura
const PROGMEM uint8_t tesoura[48 * 48 / 8] = {
0x00, 0x00, 0x00, 0x00, 0x00, 0x00, 0x00, 0x00, 0x00, 0x00, 0x00, 0x00, 0x00, 0x00, 0x00, 0x00,
0x00, 0x80, 0x40, 0x40, 0x40, 0x40, 0xC0, 0x80, 0x00, 0x00, 0x00, 0x00, 0x80, 0x40, 0x40, 0x40,
0xC0, 0x80, 0x00, 0x00, 0x00, 0x00, 0x00, 0x00, 0x00, 0x00, 0x00, 0x00, 0x00, 0x00, 0x00, 0x00,
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0x00, 0x00, 0x00, 0x00, 0x00, 0x00, 0x00, 0x00, 0x00, 0x00, 0x00, 0x00, 0x00, 0x00, 0x00, 0x00
};

//Definindo classe para pushbutton -----------------------------------------------------------------------------------------------------------------------------------------------------------------------------------------------------------------------
class PushButton {
  public:
    PushButton (byte pinBotao , byte tempoDebounce = 200 );
    void lerBotao();
    bool pressed();
    bool unpressed();
  private:
    unsigned long debounceBotao;
    bool estadoBotaoAnt = HIGH;
    bool estadoBotao;
    bool apertado;
    bool soltado;
    byte pino;
    byte tempo;  
};

//Definindo método construtor para classe PushButton
PushButton::PushButton (byte pinBotao , byte tempoDebounce){
  pinMode( pinBotao , INPUT_PULLUP ); //Indicando modo do pino como input usando o resistor de pullup interno
  debounceBotao = millis();
  pino = pinBotao;
  tempo = tempoDebounce;
}

void PushButton::lerBotao() {
  estadoBotao = digitalRead(pino);
  apertado = false;
  soltado = false;

  if ( ( millis() - debounceBotao ) > tempo ){
    if (!estadoBotao && estadoBotaoAnt) {
      apertado = true;
      debounceBotao = millis();
    } else if (estadoBotao && !estadoBotaoAnt) {
      soltado = true;
      debounceBotao = millis();
    }
  }
  estadoBotaoAnt = estadoBotao;
}

bool PushButton::pressed(){
  return apertado;
}

bool PushButton::unpressed(){
  return soltado;
}

//--------------------------------------------------------------------------------------------------------------------------------------------------------------------------------------------------------------------------------------------------------

//Instanciando objetos

PushButton botPedra  (pinBot1);
PushButton botPapel  (pinBot2);
PushButton botTesoura(pinBot3);
PushButton botSelect (pinBot4);

LCD_SSD1306 lcd; 

//Variáveis globais

byte contadorMenu = 0;
byte escolhaJogador1=0;
byte escolhaJogador2=0;
bool select = false;
String winner;

void setup() {
  //Iniciar comunicacao do lcd
  lcd.begin();
  lcd.clear();
  

}

void loop() {
  //Fazedno leitura dos botoes para atualizar as propriedades
  botSelect.lerBotao();

  if( botSelect.pressed() && (contadorMenu <= 3) ) contadorMenu++;
  if( botSelect.pressed() && contadorMenu >= 4 ) contadorMenu = 0;

  switch (contadorMenu){
    case 0:
      lcd.setCursor(40,1);
      lcd.draw( logo, 48, 48 );
      break;

    case 1:
      funcaoMenu1();
      break;
 
    case 2:
      funcaoMenu2();
      break;

    case 3:
      lcd.clear();
      lcd.println("Calculando ... !");
      lcd.print("Jaja te digo");
      
      if(escolhaJogador1 == 1){
        if(escolhaJogador2 == 1) winner = "EMPATE";
        if(escolhaJogador2 == 2) winner = "JOGADOR 2";
        if(escolhaJogador2 == 3) winner = "JOGADOR 1"; 
      }
      if(escolhaJogador1 == 2){
        if(escolhaJogador2 == 2) winner = "EMPATE";
        if(escolhaJogador2 == 3) winner = "JOGADOR 2";
        if(escolhaJogador2 == 1) winner = "JOGADOR 1"; 
      }
      if(escolhaJogador1 == 3){
        if(escolhaJogador2 == 3) winner = "EMPATE";
        if(escolhaJogador2 == 1) winner = "JOGADOR 2";
        if(escolhaJogador2 == 2) winner = "JOGADOR 1"; 
      }

      delay(4000);
      lcd.clear();
      lcd.setCursor(10,1);
      lcd.println("Resultado:");
      lcd.setCursor(10,3);
      lcd.print(winner);
      delay(5000);
      contadorMenu=0;
      lcd.clear();      
      break;      
    
  }

}

//Função para menu de usuario durante seleção da jogada
void funcaoMenu1(){

  lcd.setCursor(40,1);
  lcd.draw( logo, 48, 48 );
  lcd.setCursor(0,6);
  lcd.print("Jog: ");
  lcd.print(contadorMenu);
  select = false;
  escolhaJogador1 = 0;
  
  while(!select){
    //Leitura dos botões para atualizar as propriedades dos objetos
    botPedra.lerBotao();
    botPapel.lerBotao();
    botTesoura.lerBotao();
    botSelect.lerBotao();

    if(botPedra.pressed()){
      //Imprime Pedra
      lcd.setCursor(40,1);
      lcd.draw(pedra, 48, 48 );
      lcd.setCursor(0,6);
      lcd.print("Jog: ");
      lcd.print(contadorMenu);
      escolhaJogador1 = 1;
    } else if(botPapel.pressed()){
      //Imprime Papel
      lcd.setCursor(40,1);
      lcd.draw(papel, 48, 48 );
      lcd.setCursor(0,6);
      lcd.print("Jog: ");
      lcd.print(contadorMenu);
      escolhaJogador1 = 2;
    } else if(botTesoura.pressed()){
      //Imprime Tesoura
      lcd.setCursor(40,1);
      lcd.draw(tesoura, 48, 48 );
      lcd.setCursor(0,6);
      lcd.print("Jog: ");
      lcd.print(contadorMenu);
      escolhaJogador1 = 3;
    }

    if(botSelect.pressed() && (escolhaJogador1 != 0) ) {
      select = true;    
      contadorMenu++;
    }
    
  }
    
}

void funcaoMenu2(){

  lcd.setCursor(40,1);
  lcd.draw( logo, 48, 48 );
  lcd.setCursor(0,6);
  lcd.print("Jog: ");
  lcd.print(contadorMenu);
  select = false;
  escolhaJogador2 = 0;
  
  while(!select){
    //Leitura dos botões para atualizar as propriedades dos objetos
    botPedra.lerBotao();
    botPapel.lerBotao();
    botTesoura.lerBotao();
    botSelect.lerBotao();

    if(botPedra.pressed()){
      //Imprime Pedra
      lcd.setCursor(40,1);
      lcd.draw(pedra, 48, 48 );
      lcd.setCursor(0,6);
      lcd.print("Jog: ");
      lcd.print(contadorMenu);
      escolhaJogador2 = 1;
    } else if(botPapel.pressed()){
      lcd.setCursor(40,1);
      lcd.draw(papel, 48, 48 );
      lcd.setCursor(0,6);
      lcd.print("Jog: ");
      lcd.print(contadorMenu);
      escolhaJogador2 = 2;
    } else if(botTesoura.pressed()){
      lcd.setCursor(40,1);
      lcd.draw(tesoura, 48, 48 );
      lcd.setCursor(0,6);
      lcd.print("Jog: ");
      lcd.print(contadorMenu);
      escolhaJogador2 = 3;
    }

    if(botSelect.pressed() && (escolhaJogador2 != 0) ) {
      select = true;    
      contadorMenu++;
    }
    
  }
  
}
